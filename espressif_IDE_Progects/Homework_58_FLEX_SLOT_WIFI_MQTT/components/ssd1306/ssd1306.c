#include "include/ssd1306.h"
#include "esp_log.h"
#include <stdio.h>
#include <string.h>

#define TAG "SSD1306"

static i2c_port_t _i2c_num = I2C_NUM_0;

// Базовий шрифт 5x7 для цифр та латинських літер
static const uint8_t font5x7[][5] = {
	{0x00, 0x00, 0x00, 0x00, 0x00}, // пробіл
	{0x00, 0x00, 0x5f, 0x00, 0x00}, // !
	{0x00, 0x07, 0x00, 0x07, 0x00}, // "
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	{0x61, 0x51, 0x49, 0x45, 0x43}	// Z
};

static uint8_t disp_buffer[1024]; // 128 * 64 / 8

static esp_err_t send_cmd(uint8_t cmd) {
	uint8_t buf[2] = {0x00, cmd};
	return i2c_master_write_to_device(_i2c_num, SSD1306_I2C_ADDR, buf, 2,
									  pdMS_TO_TICKS(100));
}

void ssd1306_init(i2c_port_t i2c_num, int sda_io, int scl_io) {
	_i2c_num = i2c_num;

	uint8_t init_cmds[] = {
		0xAE,		// Display Off
		0xD5, 0x80, // Display Clock Divide Ratio
		0xA8, 0x3F, // Multiplex Ratio
		0xD3, 0x00, // Display Offset
		0x40,		// Start Line
		0x8D, 0x14, // Charge Pump
		0x20, 0x00, // Memory Mode (Horizontal)
		0xA1,		// Segment Remap
		0xC8,		// COM Output Scan Direction
		0xDA, 0x12, // COM Pins Hardware Configuration
		0x81, 0xCF, // Contrast
		0xD9, 0xF1, // Pre-charge
		0xDB, 0x40, // VCOMH Deselect Level
		0xA4,		// Entire Display On
		0xA6,		// Normal/Inverse
		0xAF		// Display On
	};

	for (int i = 0; i < sizeof(init_cmds); i++) {
		send_cmd(init_cmds[i]);
	}
	ssd1306_clear();
	ESP_LOGI(TAG, "SSD1306 initialized successfully");
}

void ssd1306_clear(void) { memset(disp_buffer, 0, sizeof(disp_buffer)); }

// Рендеринг буфера на дисплей через I2C
static void ssd1306_flush(void) {
	send_cmd(0x21); // Column addr
	send_cmd(0);
	send_cmd(127);
	send_cmd(0x22); // Page addr
	send_cmd(0);
	send_cmd(7);

	// Надсилаємо весь буфер (розбиваємо по частинах або повністю із контрольним
	// байтом 0x40)
	uint8_t packet[130];
	packet[0] = 0x40; // Data mode
	for (int page = 0; page < 8; page++) {
		send_cmd(0xB0 + page);
		send_cmd(0x00);
		send_cmd(0x10);

		for (int x = 0; x < 128; x += 16) {
			// Передаємо блоками по 16 байт для стабільності шини
			memcpy(&packet[1], &disp_buffer[page * 128 + x], 16);
			i2c_master_write_to_device(_i2c_num, SSD1306_I2C_ADDR, packet, 17,
									   pdMS_TO_TICKS(100));
		}
	}
}

// Виведення символу в буфер (масштаб 1)
static void draw_char(int x, int y, char c) {
	if (c < ' ' || c > 'Z')
		c = ' ';
	int idx = c - ' ';
	if (idx < 0)
		idx = 0;

	for (int i = 0; i < 5; i++) {
		uint8_t line = font5x7[idx][i];
		for (int j = 0; j < 7; j++) {
			if (line & (1 << j)) {
				int px = x + i;
				int py = y + j;
				if (px >= 0 && px < 128 && py >= 0 && py < 64) {
					disp_buffer[px + (py / 8) * 128] |= (1 << (py % 8));
				}
			}
		}
	}
}

// Виведення рядка тексту в буфер
static void draw_string(int x, int y, const char *str) {
	while (*str) {
		draw_char(x, y, *str);
		x += 6; // Ширина символу 5 + 1 проміжок
		str++;
	}
}

void ssd1306_update_telemetry(const char *prefix, const char *student,
							  float temp, float pres, float hum) {
	ssd1306_clear();

	// Рядок 1: Префікс (наприклад, EMB1)
	draw_string(0, 0, prefix);

	// Рядок 2: Сабтопік (ім'я студента)
	draw_string(0, 16, student);

	// Рядок 3: Телеметрія у виді: T21.2 P762 H60%
	char line3[32];
	snprintf(line3, sizeof(line3), "T%.1f P%.0f H%.0f%%", temp, pres, hum);
	draw_string(0, 40, line3);

	// Надсилаємо оновлений буфер на фізичний дисплей
	ssd1306_flush();
}